AUTOSAR XML (schema 4-0-3)
# Copyright (C) Infineon Technologies (2015)
# All rights reserved.
package /AURIX_Uart/BswModuleDescriptions
  bsw module description Uart: category=BSW_MODULE, module-id=255  # Universal Asynchronous Reciever Transmitter Driver
    provided-entrys:
      Uart_Init
      Uart_Read
      Uart_Write
      Uart_AbortRead
      Uart_AbortWrite
      Uart_GetStatus
      Uart_GetVersionInfo
      Uart_IsrReceive
      Uart_IsrTransmit
      Uart_IsrError
    bsw module dependency DetDependency: target-module-id=15, required-entrys=Det_ReportError
    bsw internal behavior UartBehavior
      constant-memorys:
        parameter data prototype Uart_kConfigPtr: category=DATA_REFERENCE, sw-pointer-target-props={target-category=TYPE_REFERENCE, implementation-data-type=Uart_ConfigType}, type=Uart_ConfigType
      static-memorys:
        4 x data:
          Uart_BusChannelMap: implementation-data-type=Uart_ChannelIdType, type=Uart_ChannelIdType
          Uart_InitStatus: implementation-data-type=Uart_StateType, type=Uart_StateType
          Uart_ChannelInfo: implementation-data-type=Uart_ChannelInfoType, type=Uart_ChannelInfoType
          Uart_ChLock: implementation-data-type=uint32, type=uint32
      7 x bsw called entity:
        Uart_Init: implemented-entry=Uart_Init
        Uart_Read: implemented-entry=Uart_Read
        Uart_Write: implemented-entry=Uart_Write
        Uart_AbortRead: implemented-entry=Uart_AbortRead
        Uart_AbortWrite: implemented-entry=Uart_AbortWrite
        Uart_GetStatus: implemented-entry=Uart_GetStatus
        Uart_GetVersionInfo: implemented-entry=Uart_GetVersionInfo
      bsw interrupt entity Uart_IsrReceive: implemented-entry=Uart_IsrReceive, interrupt-category=CAT-1, interrupt-source=SRC_ASCLINmRX
      bsw interrupt entity Uart_IsrTransmit: implemented-entry=Uart_IsrTransmit, interrupt-category=CAT-1, interrupt-source=SRC_ASCLINmTX
      bsw interrupt entity Uart_IsrError: implemented-entry=Uart_IsrError, interrupt-category=CAT-1, interrupt-source=SRC_ASCLINmEX
package /AURIX_Uart/BswModuleEntrys
  10 x bsw module entry:
    Uart_Init: service-id=0, is-reentrant=false, is-synchronous=true, call-type=REGULAR, execution-context=TASK, sw-service-impl-policy=STANDARD
      return type Return: implementation-data-type=Std_ReturnType
      sw service arg ConfigPtr: category=DATA_REFERENCE, sw-pointer-target-props={target-category=TYPE_REFERENCE, implementation-data-type=Uart_ConfigType}
    Uart_Read: service-id=2, is-reentrant=true, is-synchronous=false, call-type=REGULAR, execution-context=TASK, sw-service-impl-policy=STANDARD
      return type Return: implementation-data-type=Uart_ReturnType
      sw service arg Channel: implementation-data-type=Uart_ChannelIdType
      sw service arg MemPtr: implementation-data-type=Uart_MemPtrType
      sw service arg Size: implementation-data-type=Uart_SizeType
    Uart_Write: service-id=3, is-reentrant=true, is-synchronous=false, call-type=REGULAR, execution-context=TASK, sw-service-impl-policy=STANDARD
      return type Return: implementation-data-type=Uart_ReturnType
      sw service arg Channel: implementation-data-type=Uart_ChannelIdType
      sw service arg MemPtr: implementation-data-type=Uart_MemPtrType
      sw service arg Size: implementation-data-type=Uart_SizeType
    Uart_AbortRead: service-id=4, is-reentrant=true, is-synchronous=true, call-type=REGULAR, execution-context=TASK, sw-service-impl-policy=STANDARD
      return type Return: implementation-data-type=Uart_SizeType
      sw service arg Channel: implementation-data-type=Uart_ChannelIdType
    Uart_AbortWrite: service-id=5, is-reentrant=true, is-synchronous=true, call-type=REGULAR, execution-context=TASK, sw-service-impl-policy=STANDARD
      return type Return: implementation-data-type=Uart_SizeType
      sw service arg Channel: implementation-data-type=Uart_ChannelIdType
    Uart_GetStatus: service-id=6, is-reentrant=true, is-synchronous=true, call-type=REGULAR, execution-context=TASK, sw-service-impl-policy=STANDARD
      return type Return: implementation-data-type=Uart_StatusType
      sw service arg Channel: implementation-data-type=Uart_ChannelIdType
    Uart_GetVersionInfo: service-id=7, is-reentrant=true, is-synchronous=true, call-type=REGULAR, execution-context=TASK, sw-service-impl-policy=MACRO
      sw service arg VersionInfoPtr: category=DATA_REFERENCE, sw-pointer-target-props={target-category=TYPE_REFERENCE, implementation-data-type=Std_VersionInfoType}
    Uart_IsrReceive: service-id=0, is-reentrant=true, is-synchronous=true, call-type=INTERRUPT, execution-context=INTERRUPT-CAT-1, sw-service-impl-policy=STANDARD
      sw service arg HwUnit: implementation-data-type=uint8
    Uart_IsrTransmit: service-id=0, is-reentrant=true, is-synchronous=true, call-type=INTERRUPT, execution-context=INTERRUPT-CAT-1, sw-service-impl-policy=STANDARD
      sw service arg HwUnit: implementation-data-type=uint8
    Uart_IsrError: service-id=0, is-reentrant=true, is-synchronous=true, call-type=INTERRUPT, execution-context=INTERRUPT-CAT-1, sw-service-impl-policy=STANDARD
      sw service arg HwUnit: implementation-data-type=uint8
package /AURIX_Uart/Implementations
  bsw implementation Uart: programming-language=C, sw-version=0.0.0, vendor-id=17, ar-release-version=4.0.3, behavior=UartBehavior, vendor-specific-module-def=Uart
    code-descriptors:
      code Files
        artifact-descriptors:
          short-label=ssc::src::Uart.c, category=SWSRC
          short-label=ssc::inc::Uart.h, category=SWHDR
          short-label=ssc::inc::Uart_Dbg.h, category=SWHDR
          short-label=mak::uart_infineon_tricore::ssc::mak::infineon_uart_cfg.mak, category=SWMAKE
          short-label=mak::uart_infineon_tricore::ssc::mak::infineon_uart_check.mak, category=SWMAKE
          short-label=mak::uart_infineon_tricore::ssc::mak::infineon_uart_defs.mak, category=SWMAKE
          short-label=mak::uart_infineon_tricore::ssc::mak::infineon_uart_rules.mak, category=SWMAKE
    compiler TASKING_COMPILE: name=TASKING, options="-c --core=tc1.6.x -t -Wa-gAHLs --emit-locals=-equ,-symbols -Wa-Ogs -Wa--error-limit=42 --iso=90 --eabi-compliant --integer-enumeration --language=-comments,-gcc,+volatile,-strings --switch=auto --align=0 --default-near-size=0 --default-a0-size=0 --default-a1-size=0 -O2ROPYG --tradeoff=4 -g --source -D_TASKING_C_TRICORE_=1 $(CALLFUNCTION)", vendor=Tasking, version=Tasking
    compiler DIAB_COMPILE: name=DIAB, options="-c -tTC27xAstep16PMG:cross -Xdialect-c89 -Xno-common -Xalign-functions=4 -Xfp-fast -Xsection-split=1 -Xkeep-assembly-file=2 -g3 -ew4084 -ei4177,4550,4549,4068,5388 -XO -D_DIABDATA_C_TRICORE_=1 $(CALLFUNCTION)", vendor=WindRiver, version=WindRiver
    compiler GNU_COMPILE:
      name=GNU
      options="-c -save-temps=obj -std=iso9899:1990 -ansi -fno-asm -ffreestanding -Wundef -Wp,-std=iso9899:1990 -fno-short-enums -fpeel-loops -falign-functions=4 -frecord-gcc-switches -fsection-anchors -funsigned-bitfields -ffunction-sections -fno-ivopts -fno-peephole2 -nostartfiles -O3 -g3 -W -Wall -Wuninitialized -DTRIBOARD_TC27XX -mcpu=tc27xx -D_GNU_C_TRICORE_=1 $(CALLFUNCTION)"
      vendor=Hightec
      version=Hightec
    generated-artifacts:
      4 x dependency on artifact, all with usages=CODEGENERATION:
        Uart_PBCfg_c: artifact-descriptor={short-label=generate::src::Uart_PBCfg.c, category=SWSRC}
        Uart_Cfg_h: artifact-descriptor={short-label=generate::inc::Uart_Cfg.h, category=SWHDR}
        Uart_xdm: artifact-descriptor={short-label=config::Uart.xdm, category=SWTOOL}
        Uart_bmd: artifact-descriptor={short-label=autosar::Uart.bmd, category=SWTOOL}
    linker TASKING_LINK: name=TASKING, options="-t -d_mcal_pjt.lsl -D__CPU__=tc27x -Cmpe:vtc -Otxycl --error-limit=42 -M -mcrfiklsmnoduq -lc -lfp -lrt", vendor=Tasking, version=Tasking
    linker DIAB_LINK: name=DIAB, options="-m6 "_mcal_pjt.dld" -lc", vendor=WindRiver, version=WindRiver
    linker GNU_LINK: name=GNU, options="-T"_mcal_pjt.ld" -nostartfiles -Wl,--allow-multiple-definition -Wl,--cref -Wl,--oformat=elf32-tricore -Wl,--mcpu=tc161 -Wl,--mem-holes -Wl,--extmap="a"", vendor=Hightec, version=Hightec
    resource consumption ResourceConsumption
      6 x memory section:
        UART_VAR_UNSPECIFIED: alignment=UNSPECIFIED, size=16, sw-addrmethod=VAR
        UART_VAR_8BIT: alignment=8, size=8, sw-addrmethod=VAR
        UART_VAR_32BIT: alignment=32, size=32, sw-addrmethod=VAR
        UART_CONST_32BIT: alignment=32, size=4, sw-addrmethod=CONST
        UART_POSTBUILDCFG: alignment=UNSPECIFIED, size=72, sw-addrmethod=CONFIG_DATA
        UART_CODE: alignment=32, size=3184, sw-addrmethod=CODE
      section name prefix UART
package /AURIX_Uart/ImplementationDataTypes
  12 x impl type, all with type-emitter=BSW:
    Uart_ConfigType: category=STRUCTURE
      element Uart_ChannelType
    Uart_ChannelType: category=STRUCTURE
      element UartNotifType
    Uart_ReturnType: compu {0=UART_OK, 0=UART_NOT_OK, 0=UART_IS_BUSY}, implementation-data-type=uint32
    Uart_StateType: compu {0=UART_UNINITIALISED, 0=UART_INITIALISED, 0=UART_OPERATION_IN_PROGRESS}, implementation-data-type=uint32
    Uart_ChannelInfoType: category=STRUCTURE
      element Uart_MemPtrType
    UartNotifType: category=STRUCTURE
      element Uart_NotificationPtrType
    Uart_ChannelIdType: implementation-data-type=uint8
    Uart_SizeType: implementation-data-type=uint16
    Uart_MemType: implementation-data-type=uint8
    Uart_MemPtrType: category=DATA_REFERENCE, sw-pointer-target-props=uint8
    Uart_StatusType: compu {0=UART_IDLE, 0=UART_UNINIT, 0=UART_BUSY}, implementation-data-type=uint32
    Uart_ErrorIdType: compu {0=UART_NO_ERR, 0=UART_PARITY_ERR, 0=UART_FRAME_ERR, 0=UART_TXOVERFLOW_ERR, 0=UART_RXOVERFLOW_ERR, 0=UART_RXUNDERFLOW_ERR}, implementation-data-type=uint32
