AUTOSAR XML (schema 4-0-3)
# Copyright (C) Infineon Technologies (2015)
# All rights reserved.
package /AUTOSAR_Port/BswModuleDescriptions
  bsw module description Port: category=BSW_MODULE, module-id=124, provided-entrys=[Port_Init, Port_SetPinDirection, Port_RefreshPortDirection, Port_SetPinMode]  # PORT Driver
    bsw module dependency DetDependency: target-module-id=15, required-entrys=Det_ReportError
    bsw module dependency SafeMcalDependency: target-module-id=255, required-entrys=SafeMcal_ReportError
    bsw internal behavior PortBehavior
      constant-memorys:
        parameter data prototype Port_kConfigPtr: category=DATA_REFERENCE, sw-pointer-target-props={target-category=TYPE_REFERENCE, implementation-data-type=Port_ConfigType}, type=Port_ConfigType
        parameter data prototype Port_kAvailablePins: implementation-data-type=uint16, type=uint16
      static-memorys:
        data Port_InitStatus: implementation-data-type=uint8, type=uint8
      4 x bsw called entity:
        Port_Init: implemented-entry=Port_Init
        Port_SetPinDirection: implemented-entry=Port_SetPinDirection
        Port_RefreshPortDirection: implemented-entry=Port_RefreshPortDirection
        Port_SetPinMode: implemented-entry=Port_SetPinMode
package /AUTOSAR_Port/BswModuleEntrys
  4 x bsw module entry, all with is-synchronous=true, call-type=REGULAR, execution-context=UNSPECIFIED, sw-service-impl-policy=STANDARD:
    Port_Init: service-id=0, is-reentrant=false
      sw service arg ConfigPtr: category=DATA_REFERENCE, sw-pointer-target-props={target-category=TYPE_REFERENCE, implementation-data-type=Port_ConfigType}
    Port_SetPinDirection: service-id=1, is-reentrant=true
      sw service arg Pin: implementation-data-type=Port_PinType
      sw service arg Direction: implementation-data-type=Port_PinDirectionType
    Port_RefreshPortDirection: service-id=2, is-reentrant=false
    Port_SetPinMode: service-id=4, is-reentrant=true
      sw service arg Pin: implementation-data-type=Port_PinType
      sw service arg Mode: implementation-data-type=Port_PinModeType
package /AUTOSAR_Port/Implementations
  bsw implementation Port: programming-language=C, sw-version=0.0.0, vendor-id=17, ar-release-version=4.0.3, behavior=PortBehavior, vendor-specific-module-def=Port
    code-descriptors:
      code Files
        artifact-descriptors:
          short-label=ssc::src::Port.c, category=SWSRC
          short-label=ssc::src::Port.h, category=SWHDR
          short-label=ssc::src::Port_Ver.h, category=SWHDR
          short-label=mak::port_infineon_tricore::ssc::mak::infineon_port_cfg.mak, category=SWMAKE
          short-label=mak::port_infineon_tricore::ssc::mak::infineon_port_check.mak, category=SWMAKE
          short-label=mak::port_infineon_tricore::ssc::mak::infineon_port_defs.mak, category=SWMAKE
          short-label=mak::port_infineon_tricore::ssc::mak::infineon_port_rules.mak, category=SWMAKE
    compiler TASKING_COMPILE: name=TASKING, options="-c --core=tc1.6.x -t -Wa-gAHLs --emit-locals=-equ,-symbols -Wa-Ogs -Wa--error-limit=42 --iso=90 --eabi-compliant --integer-enumeration --language=-comments,-gcc,+volatile,-strings --switch=auto --align=0 --default-near-size=0 --default-a0-size=0 --default-a1-size=0 -O2ROPYG --tradeoff=4 -g --source -D_TASKING_C_TRICORE_=1 $(CALLFUNCTION)", vendor=Tasking, version=Tasking
    compiler DIAB_COMPILE: name=DIAB, options="-c -tTC27xAstep16PMG:cross -Xdialect-c89 -Xno-common -Xalign-functions=4 -Xfp-fast -Xsection-split=1 -Xkeep-assembly-file=2 -g3 -ew4084 -ei4177,4550,4549,4068,5388 -XO -D_DIABDATA_C_TRICORE_=1 $(CALLFUNCTION)", vendor=WindRiver, version=WindRiver
    compiler GNU_COMPILE:
      name=GNU
      options="-c -save-temps=obj -std=iso9899:1990 -ansi -fno-asm -ffreestanding -Wundef -Wp,-std=iso9899:1990 -fno-short-enums -fpeel-loops -falign-functions=4 -frecord-gcc-switches -fsection-anchors -funsigned-bitfields -ffunction-sections -fno-ivopts -fno-peephole2 -nostartfiles -O3 -g3 -W -Wall -Wuninitialized -DTRIBOARD_TC27XX -mcpu=tc27xx -D_GNU_C_TRICORE_=1 $(CALLFUNCTION)"
      vendor=Hightec
      version=Hightec
    generated-artifacts:
      5 x dependency on artifact, all with usages=CODEGENERATION:
        Port_PBCfg_c: artifact-descriptor={short-label=generate::src::Port_PBCfg.c, category=SWSRC}
        Port_Cfg_h: artifact-descriptor={short-label=generate::src::Port_Cfg.h, category=SWHDR}
        Port_xdm: artifact-descriptor={short-label=config::Port.xdm, category=SWTOOL}
        Port_ConfigDoc_html: artifact-descriptor={short-label=generate::Port_ConfigDoc.html, category=SWTOOL}
        Port_bmd: artifact-descriptor={short-label=autosar::Port.bmd, category=SWTOOL}
    linker TASKING_LINK: name=TASKING, options="-t -d_mcal_pjt.lsl -D__CPU__=tc27x -Cmpe:vtc -Otxycl --error-limit=42 -M -mcrfiklsmnoduq -lc -lfp -lrt", vendor=Tasking, version=Tasking
    linker DIAB_LINK: name=DIAB, options="-m6 "_mcal_pjt.dld" -lc", vendor=WindRiver, version=WindRiver
    linker GNU_LINK: name=GNU, options="-T"_mcal_pjt.ld" -nostartfiles -Wl,--allow-multiple-definition -Wl,--cref -Wl,--oformat=elf32-tricore -Wl,--mcpu=tc161 -Wl,--mem-holes -Wl,--extmap="a"", vendor=Hightec, version=Hightec
    resource consumption ResourceConsumption
      6 x memory section:
        PORT_CODE: alignment=UNSPECIFIED, size=1422, sw-addrmethod=CODE
        PORT_VAR_8BIT: alignment=8, size=1, sw-addrmethod=VAR
        PORT_CONST_16BIT: alignment=16, size=80, sw-addrmethod=CONST
        PORT_VAR_32BIT: alignment=32, size=4, sw-addrmethod=VAR
        PORT_CONST_32BIT: alignment=32, size=4, sw-addrmethod=CONST
        PORT_POSTBUILDCFG: alignment=UNSPECIFIED, size=1022, sw-addrmethod=CONST
      section name prefix PORT
package /AUTOSAR_Port/ImplementationDataTypes
  4 x impl type, all with type-emitter=BSW:
    Port_ConfigType: category=STRUCTURE
      element Port_n_ConfigType*
    Port_PinType: implementation-data-type=uint32
    Port_PinDirectionType: compu {0=PORT_PIN_IN, 0=PORT_PIN_OUT}, implementation-data-type=uint32
    Port_PinModeType: implementation-data-type=uint32
